## drivers/Kconfig
```kconfig
# Copyright (c) 2021 cthings.co
# SPDX-License-Identifier: Apache-2.0

menu "Drivers"
rsource "misc/Kconfig"
endmenu
```

## drivers/misc/Kconfig
```kconfig
# Copyright (c) 2021 cthings.co
# SPDX-License-Identifier: Apache-2.0

rsource "dummy_driver/Kconfig"
```

## drivers/misc/dummy_driver/Kconfig
```kconfig
# Copyright (c) 2021 cthings.co
# SPDX-License-Identifier: Apache-2.0

menuconfig DUMMY_DRIVER
	bool "dummy driver"
	default n
	help
	  Enable Dummy Driver.

# BUILD-TIME CONFIGS:
```

## dts/bindings/misc/dummy,dummy_driver.yaml
```yaml
# Copyright (c) 2021, cthings.co
# SPDX-License-Identifier: Apache-2.0

description: Dummy driver

compatible: "dummy,dummy_driver"

include: base.yaml
```

## west.yml
```yaml
# Copyright (c) 2021 cthings.co
# SPDX-License-Identifier: Apache-2.0

manifest:
  remotes:
    - name: zephyrproject-rtos
      url-base: https://github.com/zephyrproject-rtos

  defaults:
    remote: zephyrproject-rtos

  projects:
    - name: zephyr
      repo-path: zephyr
      revision: main
      import:
        name-allowlist:
          - cmsis
          - edtt
          - fatfs
          - libmetal
          - littlefs
          - mcumgr
```
